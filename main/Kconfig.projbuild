## main/Kconfig.projbuild
```kconfig
menu "I2C Config"
        config I2C_MASTER_SCL
            int "SCL GPIO Num"
            default 5
            help
                GPIO number for I2C Master clock line.

        config I2C_MASTER_SDA
            int "SDA GPIO Num"
            default 4
            help
                GPIO number for I2C Master data line.

        config I2C_MASTER_PORT_NUM
            int "Port Number"
            default 0
            help
                Port number for I2C Master device.

        config I2C_SLAVE_ADDRESS
            int "Slave Address"
            default 120
            help
                I2C Slave device address.
endmenu
```
